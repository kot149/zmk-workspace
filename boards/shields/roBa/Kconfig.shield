## boards/shields/roBa/Kconfig.shield
```kconfig
config SHIELD_ROBA_R
    def_bool $(shields_list_contains,roBa_R)

config SHIELD_ROBA_L
    def_bool $(shields_list_contains,roBa_L)
```

## config/boards/shields/roBa/Kconfig.defconfig
```kconfig
if SHIELD_ROBA_R

    config ZMK_KEYBOARD_NAME
        default "roBa_R"

    config ZMK_SPLIT
        default y

    config ZMK_SPLIT_ROLE_CENTRAL
        default y

endif

if SHIELD_ROBA_L

    config ZMK_KEYBOARD_NAME
        default "roBa_L"

    config ZMK_SPLIT
        default y

endif
```

## config/west.yml
```yaml
manifest:
  projects:
    - name: zmk
      url: https://github.com/zmkfirmware/zmk
      revision: main
      import: app/west.yml
    - name: zmk-pmw3610-driver
      url: https://github.com/kot149/zmk-pmw3610-driver
      revision: main
      path: modules/zmk-pmw3610-driver
    - name: zmk-listeners
      url: https://github.com/ssbb/zmk-listeners
      revision: v1
      path: modules/zmk-listeners
    - name: zmk-rgbled-widget
      url: https://github.com/caksoylar/zmk-rgbled-widget
      revision: main
      path: modules/zmk-rgbled-widget
  self:
    path: config
```
